/**
 * @file ssd1306_oled.cpp
 * @brief SSD1306 OLED 驱动实现（硬件 I2C2）
 *
 * SSD1306 128x64 OLED 驱动，通过硬件 I2C2（PB10/PB11）通信。
 * 与 AHT20/SHT45 温湿度传感器共用同一条 I2C 总线，地址不同不冲突：
 *   AHT20 = 0x38, SHT45 = 0x44, SSD1306 = 0x3C
 *
 * 与 DZRAB 版本的区别：
 *   DZRAB 使用软件 I2C（g_aht20.bus_start/bus_write/bus_stop）
 *   本版本使用硬件 I2C2（i2c2_write()），速度更快、CPU 占用更低
 *
 * 字模移植自江协科技 OLED 库（STM32 参考），仅作字模数据来源。
 * 实际硬件为 BMCU 主板 CH32V203。
 */

#include "ssd1306_oled.h"
#include <stddef.h>
#include "i2c2.h"          // 硬件 I2C2 驱动：i2c2_init / i2c2_write
#include "hal/time_hw.h"   // delay() / time_ms64()
#include "ams.h"           // ams[] / _filament（只读）
#include "bambu_bus_ams.h" // 【修复】bambubus_local_ams_index()：AUTO 寻址下不能直接用 BAMBU_BUS_AMS_NUM 当下标
#include "fx_units.h"      // 【定点化】fx_meters_le：避免浮点比较助手
#include "ch32v20x.h"      // CH32V203 寄存器定义（用于 probe_ack 的 I2C 标志位检查）
#include "ch32v20x_i2c.h"  // I2C 外设操作函数

#if BMCU_OLED

/* ==================== 轻量字符串辅助 ==================== */

static bool str_eq(const char* a, const char* b)
{
    if (!a || !b) return false;
    while (*a && *a == *b) { a++; b++; }
    return (*a == *b);
}

static void str_cpy(char* dst, const char* src)
{
    if (!dst) return;
    if (!src) { *dst = 0; return; }
    while (*src) *dst++ = *src++;
    *dst = 0;
}

/* 子串匹配（不区分大小写） */
static bool str_contains(const char* hay, const char* needle)
{
    if (!hay || !needle) return false;
    for (int i = 0; hay[i]; i++)
    {
        int j = 0;
        while (hay[i + j] && needle[j] && hay[i + j] == needle[j]) j++;
        if (!needle[j]) return true;
    }
    return false;
}

/* 从耗材名称关键词识别材质（第三方耗材 filament_id 常不规范，靠名称兜底） */
static const char* material_from_name(const char* nm)
{
    if (!nm) return NULL;

    char up[20];
    int ul = 0;
    for (int i = 0; nm[i] && ul < 19; i++)
    {
        char c = nm[i];
        if (c >= 'a' && c <= 'z') c = (char)(c - 'a' + 'A');
        up[ul++] = c;
    }
    up[ul] = 0;

    if (str_contains(up, "PETG")) return "PETG";
    if (str_contains(up, "PCTG")) return "PCTG";
    if (str_contains(up, "PLA"))  return "PLA";
    if (str_contains(up, "ABS"))  return "ABS";
    if (str_contains(up, "ASA"))  return "ASA";
    if (str_contains(up, "NYLON")) return "PA";
    if (str_contains(up, "PC"))   return "PC";
    if (str_contains(up, "PA"))   return "PA";
    if (str_contains(up, "TPU"))  return "TPU";
    return NULL;
}

/* ==================== 硬件 I2C2 底层 ==================== */

/**
 * @brief OLED I2C 写命令（单字节）
 *
 * I2C 时序：START → 0x78(addr+W) → 0x00(命令模式) → cmd → STOP
 * 使用硬件 I2C2，比软件 bit-bang 更快更稳定
 */
void SSD1306_OLED::write_cmd(uint8_t c)
{
    if (!s_ready) return;
    uint8_t buf[2] = { 0x00u, c };
    if (i2c2_write(BMCU_OLED_ADDR, buf, 2))
        s_ready = false;   // I2C 写失败（NACK/超时）→ 标记 OLED 不在线，后续全部跳过
}

/**
 * @brief OLED I2C 写数据（单字节）
 *
 * I2C 时序：START → 0x78(addr+W) → 0x40(数据模式) → data → STOP
 */
void SSD1306_OLED::write_data(uint8_t d)
{
    if (!s_ready) return;
    uint8_t buf[2] = { 0x40u, d };
    if (i2c2_write(BMCU_OLED_ADDR, buf, 2))
        s_ready = false;
}

/**
 * @brief OLED I2C 连续写数据（多字节，单次事务）
 *
 * SSD1306 支持连续写：一次 START + 地址 + 控制字节(0x40) 后，
 * 可连续发任意多个数据字节，最后 STOP。比逐字节事务效率高得多。
 * 硬件 I2C2 下一次事务可发最多 128+1=129 字节（清一整页）。
 */
static void oled_write_data_bulk(const uint8_t* data, uint8_t n)
{
    if (!SSD1306_OLED::is_ready() || n == 0) return;
    uint8_t buf[129];
    buf[0] = 0x40u;
    for (uint8_t i = 0; i < n; i++)
        buf[i + 1u] = data[i];
    if (i2c2_write(BMCU_OLED_ADDR, buf, (uint32_t)(n + 1u)))
        SSD1306_OLED::set_not_ready();
}

/* ==================== 探测 OLED ACK ==================== */

/**
 * @brief 探测 OLED 是否在线（ACK 检测）
 *
 * 仅发送 I2C 地址字节，检查从机是否 ACK。
 * 不修改 s_ready，仅返回探测结果。用于运行时热插拔检测。
 *
 * CH32V203 硬件 I2C 的 AF（Acknowledge Failure）标志位在从机 NACK 时置位，
 * 读取后自动清除。通过检查此标志位判断设备是否应答。
 */
bool SSD1306_OLED::probe_ack()
{
    /* 先清除残留的 AF 标志和总线状态，避免上次事务遗留误判 */
    I2C_ClearFlag(I2C2, I2C_FLAG_AF);
    I2C_ClearFlag(I2C2, I2C_FLAG_BERR);

    /* 等待总线空闲；若 SDA 被拉低（总线挂死），做一次总线复位 */
    uint32_t t0 = time_ms64();
    while (I2C_GetFlagStatus(I2C2, I2C_FLAG_BUSY))
    {
        if ((time_ms64() - t0) > 50u)
        {
            /* 总线挂死：软件复位 I2C2 外设 */
            I2C_Cmd(I2C2, DISABLE);
            I2C_SoftwareResetCmd(I2C2, ENABLE);
            I2C_SoftwareResetCmd(I2C2, DISABLE);
            I2C_Cmd(I2C2, ENABLE);
            delay(1);
            /* 复位后再清 AF */
            I2C_ClearFlag(I2C2, I2C_FLAG_AF);
            return false;
        }
    }

    /* 发送 START */
    I2C_GenerateSTART(I2C2, ENABLE);
    t0 = time_ms64();
    while (!I2C_CheckEvent(I2C2, I2C_EVENT_MASTER_MODE_SELECT))
    {
        if ((time_ms64() - t0) > 50u) { I2C_GenerateSTOP(I2C2, ENABLE); return false; }
    }

    /* 发送从机地址 + 写位 */
    I2C_Send7bitAddress(I2C2, (uint8_t)(BMCU_OLED_ADDR << 1u), I2C_Direction_Transmitter);
    t0 = time_ms64();
    while (!I2C_CheckEvent(I2C2, I2C_EVENT_MASTER_TRANSMITTER_MODE_SELECTED))
    {
        if ((time_ms64() - t0) > 50u) { I2C_GenerateSTOP(I2C2, ENABLE); return false; }
    }

    /* 检查 AF 标志：从机 NACK 时置位 */
    bool ack = !I2C_GetFlagStatus(I2C2, I2C_FLAG_AF);
    I2C_GenerateSTOP(I2C2, ENABLE);
    I2C_ClearFlag(I2C2, I2C_FLAG_AF);
    return ack;
}

/* ==================== 显示起始位置 ==================== */

/**
 * @brief 设置显示起始位置（页寻址模式）
 * @param page 页地址 0~7（每页 8 像素高）
 * @param col  列地址 0~127
 */
void SSD1306_OLED::set_pos(uint8_t page, uint8_t col)
{
    write_cmd(0xB0u + (page & 0x07u));             // 页地址
    write_cmd(0x00u + (col & 0x0Fu));              // 列低 4 位
    write_cmd(0x10u + ((col >> 4u) & 0x0Fu));      // 列高 4 位
}

/* ==================== 8x16 ASCII 字模 ==================== */

/**
 * 8x16 ASCII 字模（移植自江协科技 OLED 库）
 * 字符范围 0x20~0x7E（空格 ~ ~），共 95 个字符，每字符 16 字节
 */
static const uint8_t OLED_F8x16[95u][16u] = {
    0x00,0x00,0x00,0x00,0x00,0x00,0x00,0x00, 0x00,0x00,0x00,0x00,0x00,0x00,0x00,0x00,//  0
    0x00,0x00,0x00,0xF8,0x00,0x00,0x00,0x00, 0x00,0x00,0x00,0x33,0x30,0x00,0x00,0x00,//! 1
    0x00,0x10,0x0C,0x06,0x10,0x0C,0x06,0x00, 0x00,0x00,0x00,0x00,0x00,0x00,0x00,0x00,//" 2
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    0x00,0x06,0x01,0x01,0x02,0x02,0x04,0x04, 0x00,0x00,0x00,0x00,0x00,0x00,0x00,0x00,//~ 94
};

/* ==================== 初始化命令序列 ==================== */

/**
 * SSD1306 初始化命令序列（严格对齐江协科技 OLED_Init，字节一致）
 * 每个命令含参数的为一对字节，无参数的为单字节
 */
static const uint8_t InitCmd[] = {
    0xAE,        // 关闭显示
    0xD5,0x80,   // 设置时钟分频
    0xA8,0x3F,   // 多路复用率 1/64
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    0x8D,0x14,   // 电荷泵开启
    0xAF         // 开启显示
};

/* ==================== 驱动层实现 ==================== */

void SSD1306_OLED::init()
{
    /* 确保 I2C2 已初始化（th_sensor_init 通常已调用，此处冗余安全） */
    i2c2_init();

    delay(200);   // 上电稳定（SSD1306 上电到可收命令需 >100ms）

    /* 开机探测 OLED ACK：此时 I2C 总线干净，探测可靠。
     * 有屏→s_ready=true，后续正常显示。
     * 无屏→s_ready=false，所有写操作零开销跳过，不影响打印机通信。 */
    s_ready = probe_ack();

    /* 发送初始化命令序列 */
    for (uint8_t i = 0; i < sizeof(InitCmd); i++)
        write_cmd(InitCmd[i]);

    clear();
}

void SSD1306_OLED::clear()
{
    static const uint8_t zero[OLED_W] = {0};   // 128 字节全 0 = 清屏像素
    for (uint8_t page = 0; page < 8; page++)
    {
        set_pos(page, 0);
        oled_write_data_bulk(zero, OLED_W);     // 一次事务清一整页（128 字节）
    }
    /* 同步清空行缓存 */
    for (uint8_t r = 0; r < OLED_LINES; r++)
        s_line_buf[r][0] = '\0';
}

void SSD1306_OLED::clear_line(uint8_t row)
{
    if (row >= OLED_LINES) return;
    uint8_t page0 = (uint8_t)(row * 2u);   // 8x16 字模占 2 页
    static const uint8_t zero[OLED_W] = {0};
    for (uint8_t p = 0; p < 2; p++)
    {
        set_pos((uint8_t)(page0 + p), 0);
        oled_write_data_bulk(zero, OLED_W);
    }
}

void SSD1306_OLED::show_char(uint8_t row, uint8_t col, char ch)
{
    if (row >= OLED_LINES || col >= OLED_COLS) return;
    if (ch < 0x20 || ch > 0x7E) ch = ' ';   // 越界字符显示为空格
    uint8_t x   = (uint8_t)(col * 8u);
    uint8_t pg0 = (uint8_t)(row * 2u);
    const uint8_t* p = OLED_F8x16[(uint8_t)ch - 0x20u];

    /* 上 8 行：一次事务连续写 8 字节 */
    set_pos(pg0, x);
    oled_write_data_bulk(p, 8u);
    /* 下 8 行：一次事务连续写 8 字节 */
    set_pos((uint8_t)(pg0 + 1u), x);
    oled_write_data_bulk(p + 8u, 8u);
}

void SSD1306_OLED::show_text(uint8_t row, uint8_t col, const char* str)
{
    if (!str) return;
    uint8_t c = col;
    while (*str && c < OLED_COLS)
    {
        show_char(row, c++, *str);
        str++;
    }
}

/* ==================== 内容层：去闪烁核心 ==================== */

void SSD1306_OLED::draw_line_if_changed(uint8_t row, const char* text)
{
    if (row >= OLED_LINES) return;
    if (str_eq(s_line_buf[row], text)) return;   // 未变化，不动屏幕
    str_cpy(s_line_buf[row], text);
    clear_line(row);
    show_text(row, 0, text);
}

/* ==================== 内容层：温湿度画面 ==================== */

void SSD1306_OLED::draw_message(const char* line0, const char* line1,
                                 const char* line2, const char* line3)
{
    if (!s_ready) return;
    draw_line_if_changed(0, line0 ? line0 : "");
    draw_line_if_changed(1, line1 ? line1 : "");
    draw_line_if_changed(2, line2 ? line2 : "");
    draw_line_if_changed(3, line3 ? line3 : "");
}

void SSD1306_OLED::draw_aht20(bool aht20_present, bool online, int16_t temperature_dc, uint16_t humidity_dc, bool comm_ok)
{
    if (!s_ready)
    {
        draw_line_if_changed(0, "OLED NO ACK");
        return;
    }

    /* 板上无 AHT20：不显示任何温湿度 */
    if (!aht20_present)
    {
        draw_line_if_changed(0, "NO SENSOR");
        draw_line_if_changed(1, "");
        draw_line_if_changed(2, "");
        draw_line_if_changed(3, "");
        return;
    }

    /* 行0：标题（固定） */
    draw_line_if_changed(0, "SENSOR T/H");

    if (!online)
    {
        draw_line_if_changed(1, "SENSOR");
        draw_line_if_changed(2, "OFFLINE");
        draw_line_if_changed(3, "");
        return;
    }

    /* 行1：温度/湿度（【定点化】入参已是 0.1°C / 0.1%RH 整数, 无需再换算） */
    int16_t ti = temperature_dc;
    uint16_t hi = humidity_dc;

    char thbuf[OLED_COLS + 1u];
    for (uint8_t i = 0; i < OLED_COLS; i++) thbuf[i] = ' ';
    thbuf[OLED_COLS] = 0;
    int n = 0;
    thbuf[n++] = 'T'; thbuf[n++] = ':';
    if (ti < 0) { ti = (int16_t)(-ti); thbuf[n++] = '-'; }
    thbuf[n++] = (char)('0' + (ti / 100) % 10);
    thbuf[n++] = (char)('0' + (ti / 10) % 10);
    thbuf[n++] = '.';
    thbuf[n++] = (char)('0' + (ti % 10));
    thbuf[n++] = 'C';
    thbuf[n++] = ' '; thbuf[n++] = ' ';
    thbuf[n++] = 'H'; thbuf[n++] = ':';
    thbuf[n++] = (char)('0' + (hi / 100) % 10);
    thbuf[n++] = (char)('0' + (hi / 10) % 10);
    thbuf[n++] = '.';
    thbuf[n++] = (char)('0' + (hi % 10));
    thbuf[n++] = '%';
    draw_line_if_changed(1, thbuf);

    /* 行2：通讯状态 */
    draw_line_if_changed(2, comm_ok ? "COMM OK " : "COMM ERR");

    /* 行3：写死 TPU 型号摘要（LOCK 标识，紧凑显示末两位：GFU02->02） */
    char lbuf[OLED_COLS + 1u];
    for (uint8_t i = 0; i < OLED_COLS; i++) lbuf[i] = ' ';
    lbuf[OLED_COLS] = 0;
    int ln = 0;
    lbuf[ln++] = 'L'; lbuf[ln++] = ':';
    for (uint8_t c = 0; c < 4; c++)
    {
        const char* id = TPU_FIXED_ID[c];
        int idlen = 0;
        while (id && id[idlen]) idlen++;
        if (idlen >= 2) { lbuf[ln++] = id[idlen - 2]; lbuf[ln++] = id[idlen - 1]; }
        else if (id && idlen == 1) { lbuf[ln++] = id[0]; }
        if (c < 3) lbuf[ln++] = '/';
    }
    draw_line_if_changed(3, lbuf);
}

/* ==================== 内容层：四通道概览 ==================== */

const char* SSD1306_OLED::motion_label(_filament_motion m)
{
    switch (m)
    {
        case _filament_motion::idle:             return "IDLE";
        case _filament_motion::send_out:         return "LOAD";
        case _filament_motion::before_on_use:    return "PREP";
        case _filament_motion::on_use:           return "FEED";
        case _filament_motion::stop_on_use:      return "STOP";
        case _filament_motion::before_pull_back: return "PRET";
        case _filament_motion::pull_back:        return "UNLD";
        default:                                 return "----";
    }
}

const char* SSD1306_OLED::material_label(uint8_t ch)
{
    if (ch >= 4) return "----";
    const _filament& f = ams[bambubus_local_ams_index()].filament[ch];

    /* TPU 材质：显示内部写死型号（如 GFU98/GFU90） */
    if (f.filament_type == _filament_type::tpu)
    {
        const char* id = TPU_FIXED_ID[ch];
        if (id && id[0]) return id;
        return "TPU?";
    }

    /* 非 TPU：优先用 Bambu 下发的 filament_id（如 GFG00/GFA00/GFB01） */
    if (f.bambubus_filament_id[0] && f.bambubus_filament_id[1])
    {
        const char* id = f.bambubus_filament_id;
        if (id[0] == 'G' && id[1] == 'F' && id[2] == 'G') return "PETG";
        if (id[0] == 'G' && id[1] == 'F' && id[2] == 'A') return "PLA";
        if (id[0] == 'G' && id[1] == 'F' && id[2] == 'B') return "ABS";
        if (id[0] == 'G' && id[1] == 'F' && id[2] == 'P') return "PC";
        if (id[0] == 'G' && id[1] == 'F' && id[2] == 'L') return "PA";
        if (id[0] == 'G' && id[1] == 'F' && id[2] == 'U') return "TPU";
        if (id[0] == 'A' && id[1] == 'B' && id[2] == 'S') return "ABS";

        /* id 未识别（第三方耗材）：改用名称关键词确认 */
        const char* m = material_from_name(f.name);
        if (m) return m;

        /* 无法识别：显示材质字母+两位序号（如 G00），保证有内容可看 */
        static char buf[8];
        buf[0] = id[2];
        buf[1] = id[3];
        buf[2] = id[4];
        buf[3] = 0;
        return buf;
    }

    if (f.name[0])
    {
        const char* m = material_from_name(f.name);
        if (m) return m;
        return f.name;
    }
    return "UNKN";
}

const char* SSD1306_OLED::color_name(uint8_t r, uint8_t g, uint8_t b)
{
    if (r < 30 && g < 30 && b < 30) return "BLACK";
    if (r > 225 && g > 225 && b > 225) return "WHITE";
    if (r >= g && r >= b)
    {
        if (g > 120 && b > 120) return "ORANGE";
        if (b > 120) return "PURPLE";
        if (g > 120) return "YELLOW";
        return "RED";
    }
    if (g >= r && g >= b)
    {
        if (r > 120 && b > 120) return "CYAN";
        if (b > 120) return "CYAN";
        if (r > 120) return "YELLOW";
        return "GREEN";
    }
    if (r > 120 && g > 120) return "CYAN";
    if (r > 120) return "PURPLE";
    if (g > 120) return "CYAN";
    return "BLUE";
}

void SSD1306_OLED::draw_channels()
{
    if (!s_ready) return;

    for (uint8_t r = 0; r < 4; r++)
    {
        char line[OLED_COLS + 1u];
        for (uint8_t i = 0; i < OLED_COLS; i++) line[i] = ' ';
        line[OLED_COLS] = 0;

        const _filament& f = ams[bambubus_local_ams_index()].filament[r];

        int n = 0;
        line[n++] = (char)('0' + r);
        line[n++] = ':';

        if (!f.online)
        {
            line[n++] = 'E'; line[n++] = 'M'; line[n++] = 'P'; line[n++] = 'T'; line[n++] = 'Y';
        }
        else if (fx_meters_le(f.meters, 0.05f))   /* 【定点化】纯位运算比较，不引入 __lesf2 */
        {
            line[n++] = 'N'; line[n++] = 'U'; line[n++] = 'L'; line[n++] = 'L';
            const char* c = color_name(f.color_R, f.color_G, f.color_B);
            for (int k = 0; c && c[k] && k < 7; k++) line[8 + k] = c[k];
        }
        else
        {
            const char* mat = material_label(r);
            int mi = 0;
            while (mat && mat[mi] && mi < 5) line[n++] = mat[mi++];
            while (n < 8) line[n++] = ' ';
            const char* c = color_name(f.color_R, f.color_G, f.color_B);
            for (int k = 0; c && c[k] && k < 7; k++) line[8 + k] = c[k];
        }

        draw_line_if_changed(r, line);
    }
}

/* ==================== 动作覆盖 + 页面轮询 ==================== */

void SSD1306_OLED::notify_action(uint8_t ch, oled_action act)
{
    if (!s_ready) return;
    if (ch >= 4) return;
    if (act == oled_action::action_none) return;
    s_action     = act;
    s_action_ch  = ch;
    s_action_until_ms = time_ms64() + OLED_ACTION_HOLD_MS;
    s_page_next_ms = 0;   // 立即打断轮询
}

void SSD1306_OLED::tick(bool aht20_present, bool aht20_online,
                        int16_t temperature_dc, uint16_t humidity_dc,
                        bool comm_ok)
{
    if (!s_ready)
    {
        /* 未检测到屏时，每 3 秒重探一次以支持中途插入 */
        static uint64_t s_last_probe_ms = 0;
        const uint64_t now = time_ms64();
        if (now - s_last_probe_ms < 3000u) return;
        s_last_probe_ms = now;
        if (!probe_ack()) return;
        s_ready = true;
        i2c2_init();
        delay(200);
        for (uint8_t i = 0; i < sizeof(InitCmd); i++)
            write_cmd(InitCmd[i]);
        clear();
        return;
    }

    const uint64_t now = time_ms64();

    /* ===== 1) 动作覆盖优先 ===== */
    if (s_action != oled_action::action_none && now < s_action_until_ms)
    {
        char l0[OLED_COLS + 1u];
        const char* actxt = "NONE";
        switch (s_action)
        {
            case oled_action::action_load:   actxt = "LOADING";  break;
            case oled_action::action_unload: actxt = "UNLOAD";   break;
            case oled_action::action_feed:   actxt = "FEEDING";  break;
            case oled_action::action_idle:   actxt = "STOP";     break;
            default:                         actxt = "NONE";     break;
        }
        int k = 0;
        l0[k++] = 'C'; l0[k++] = 'H'; l0[k++] = (char)('0' + s_action_ch); l0[k++] = ' ';
        for (int i = 0; actxt[i] && k < 16; i++) l0[k++] = actxt[i];
        while (k < 16) l0[k++] = ' ';
        l0[16] = 0;
        draw_line_if_changed(0, l0);
        draw_line_if_changed(1, material_label(s_action_ch));

        const char* hint = "";
        switch (s_action)
        {
            case oled_action::action_load:   hint = "feed in";   break;
            case oled_action::action_unload: hint = "pull out";  break;
            case oled_action::action_feed:   hint = "supplying"; break;
            default:                         hint = "";          break;
        }
        draw_line_if_changed(2, hint);
        draw_line_if_changed(3, "");
        return;
    }

    /* 动作结束：清动作状态，回轮询 */
    if (s_action != oled_action::action_none)
    {
        s_action = oled_action::action_none;
        s_action_ch = 0xFFu;
        clear();
    }

    /* ===== 2) 页面轮询 ===== */
    if (s_page_next_ms == 0u)
    {
        s_page_next_ms = now + OLED_PAGE_DWELL_MS;
    }
    else if (now >= s_page_next_ms)
    {
        s_page = (oled_page)((uint8_t)s_page + 1u);
        if (s_page >= oled_page::page_count) s_page = oled_page::page_aht20;
        s_page_next_ms = now + OLED_PAGE_DWELL_MS;
        clear();
    }

    switch (s_page)
    {
        case oled_page::page_aht20:
            draw_aht20(aht20_present, aht20_online, temperature_dc, humidity_dc, comm_ok);
            break;
        case oled_page::page_channels:
            draw_channels();
            break;
        default:
            break;
    }
}

#endif // BMCU_OLED
